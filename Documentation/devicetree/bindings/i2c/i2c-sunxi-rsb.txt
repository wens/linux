## Documentation/devicetree/bindings/i2c/i2c-sunxi-rsb.txt
```
* Allwinner RSB (Reduced Serial Bus) controller

Required properties :

 - reg             : Offset and length of the register set for the device.
 - compatible      : Should be "allwinner,sun8i-a23-rsb".
 - interrupts      : The interrupt line connected to the RSB peripheral.
 - clocks          : The gate clk connected to the RSB peripheral.
 - resets          : The reset line connected to the RSB peripheral.

Optional properties :

 - clock-frequency : Desired RSB bus clock frequency in Hz. If not set
		     the default frequency is 100kHz. Maximum is 20MHz.

An RSB device node may contain up to 15 child nodes each encoding an RSB
slave device.

Slave device properties:
  Required properties:
   - reg           : The runtime address used to access the device.
   - allwinner,rsb-hw-addr : The RSB hardware address for the device. This
			     is only used when configuring the runtime
			     address of the device.

  Valid runtime addresses - There are only 15 valid runtime addresses:

      0x17, 0x2d, 0x3a, 0x4e, 0x59, 0x63, 0x74, 0x8b,
      0x9c, 0xa6, 0xb1, 0xc5, 0xd2, 0xe8, 0xff


Example:

	rsb@01f03400 {
		compatible = "allwinner,sun8i-a23-rsb";
		reg = <0x01f03400 0x400>;
		interrupts = <0 39 4>;
		clocks = <&apb0_gates 3>;
		clock-frequency = <3000000>;
		resets = <&apb0_rst 3>;

		axp223: pmic@2d {
			compatible = "x-powers,axp223", "x-powers,axp221";
			reg = <0x2d>;
			allwinner,rsb-hw-addr = <0x3e3>;

			/* ... */
		};
	};
```

## Documentation/devicetree/bindings/net/realtek-bluetooth.txt
```
Realtek Bluetooth Chips
-----------------------

This documents the binding structure and common properties for serial
attached Realtek devices.

Serial attached Realtek devices shall be a child node of the host UART
device the slave device is attached to. See ../serial/slave-device.txt
for more information

Required properties:
- compatible: should contain one of the following:
    * "realtek,rtl8723bs-bt"
    * "realtek,rtl8723ds-bt"
- vbat-supply: regulator specifier, used to supply core voltage
- vddio-supply: regulator specifier, used to supply I/O voltage

Optional properties:
- enable-gpios: GPIO specifier, used to enable/disable the Bluetooth module
- device-wake-gpios: GPIO specifier, used to wake the Bluetooth module
- host-wake-gpios: GPIO specifier, used to wake the system


Example:

&uart {
	...

	bluetooth {
		compatible = "realtek,rtl8723bs-bt";
		vbat-supply = <&reg_dldo4>;
		vddio-supply = <&reg_eldo1>;
		device-wakeup-gpios = <&r_pio 0 6 GPIO_ACTIVE_HIGH>; /* PL6 */
		host-wakeup-gpios = <&r_pio 0 5 GPIO_ACTIVE_HIGH>; /* PL5 */
		enable-gpios = <&r_pio 0 4 GPIO_ACTIVE_HIGH>; /* PL4 */
	};
};
```

## drivers/gpu/drm/sun4i/Kconfig
```kconfig
config DRM_SUN4I
	tristate "DRM Support for Allwinner A10 Display Engine"
	depends on DRM && ARM && COMMON_CLK
	depends on ARCH_SUNXI || COMPILE_TEST
	select DRM_GEM_CMA_HELPER
	select DRM_KMS_HELPER
	select DRM_KMS_CMA_HELPER
	select DRM_PANEL
	select REGMAP_MMIO
	select VIDEOMODE_HELPERS
	help
	  Choose this option if you have an Allwinner SoC with a
	  Display Engine. If M is selected the module will be called
	  sun4i-drm.

config DW_HDMI_SUNXI
	tristate "Allwinner specific extensions for Synopsys DW HDMI"
	depends on DRM_SUN4I
	select DRM_DW_HDMI
	help
	  This selects support for Allwinner SoC specific extensions
	  for the Synopsys DesignWare HDMI driver.
```
